## drivers/soc/ambarella/Kconfig
```kconfig
#
# Ambarella SoC drivers
#

config AMBARELLA_SUPPORT_GDMA
	bool "Ambarella Enable GDMA"
        depends on ARCH_AMBARELLA
	default n
	help
	  Say y here to enable gdma

config RPMSG_AMBARELLA_VIRTIO
	tristate "Ambarella RPMSG VirtIO"
	depends on ARCH_AMBARELLA
	select RPMSG
	select RPMSG_VIRTIO
	select RPMSG_CHAR
	select VIDEOBUF2_DMA_CONTIG
	select MEDIA_SUPPORT
	help
	  Say Y here to support Ambarella RPMSG
```
